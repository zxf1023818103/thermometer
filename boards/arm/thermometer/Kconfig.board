## boards/arm/thermometer/Kconfig.board
```kconfig
# Thermometer board configuration

config BOARD_THERMOMETER
	bool "Thermometer board"
	depends on SOC_NRF52811_QFAA
```

## boards/arm/thermometer/Kconfig.defconfig
```kconfig
# nRF52840 DK NRF52811 board configuration

# Copyright (c) 2019 Nordic Semiconductor ASA
# SPDX-License-Identifier: Apache-2.0

if BOARD_THERMOMETER

config BOARD
	default "thermometer"

config BT_CTLR
	default BT

endif # thermometer
```
